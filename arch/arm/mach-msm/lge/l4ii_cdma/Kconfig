## arch/arm/mach-msm/lge/l4ii_cdma/Kconfig
```kconfig
config MACH_MSM7X27A_L4II_CDMA
    depends on ARCH_MSM7X27A
    depends on !MSM_STACKED_MEMORY
    select MACH_LGE
    bool "MSM7x27A L4II_CDMA"
    help
        Support for the LG Electronics MSM7x27A L4II_CDMA.

config MACH_MSM7X27A_L4II_CDMA_NO_DEBUG
    depends on MACH_MSM7X27A_L4II_CDMA
	default n
    bool "MSM7x27A L4II_CDMA DEBUG Option"
    help
        Support for the LG Electronics MSM7x27A L4II_CDMA.

config LGE_BATTERY_SUSPEND_RESUME
    depends on ARCH_MSM7X27A
    select MACH_LGE
    bool "MSM7x25A L4II_CDMA"
    help
         Support for the LG Electronics Power.

config LGE_DETECT_USB_CABLE_TYPE
    bool "Check the type of usb cable is connected to Handset"
    depends on MACH_LGE
    default n
    help
         Check the type of usb cable is connected to handset, like Factory USB or UART, normal
         charger and unknown cable.
```

## arch/arm/mach-msm/lge/v1/Kconfig
```kconfig
config MACH_MSM7X25A_V1
    depends on ARCH_MSM7X27A
    depends on !MSM_STACKED_MEMORY
    select MACH_LGE
    bool "MSM7x25A V1"
    help
        Support for the LG Electronics MSM7x25AB V1.

config MACH_MSM7X25A_V1_DS
    depends on ARCH_MSM7X27A
    depends on !MSM_STACKED_MEMORY
    select MACH_LGE
    bool "MSM7x25A V1"
    help
        Support for the LG Electronics MSM7x25AB V1.

config LGE_BATTERY_SUSPEND_RESUME
    depends on ARCH_MSM7X27A
    select MACH_LGE
    bool "MSM7x25A V1"
    help
        Support for the LG Electronics Power.  		

config APPLY_LATEST_KERNEL_PATCHES
    bool "Apply patches for kernel Org"
    depends on MACH_MSM7X25A_V1 || MACH_MSM7X25A_V1_DS
    default n
    help
        Latest bug fixes,memory leak fixes & performance
        optimizations from kernel 3.4.Y .
        
config LGE_ADUIO_FM_DIGITAL
    depends on ARCH_MSM7X27A
    select MACH_LGE
    bool "MSM7x25A V1"
    help
        Support for the Digital FM.
```
